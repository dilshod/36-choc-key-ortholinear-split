## rev0/zmk-config/config/boards/shields/1984x/Kconfig.shield
```kconfig
config SHIELD_1984X_LEFT
    def_bool $(shields_list_contains,1984x_left)

config SHIELD_1984X_RIGHT
    def_bool $(shields_list_contains,1984x_right)
```

## rev1/zmk-config/config/boards/shields/nrf5340/Kconfig.defconfig
```kconfig
if SHIELD_1984_LEFT

config ZMK_KEYBOARD_NAME
  default "1984"

config ZMK_SPLIT_ROLE_CENTRAL
  default y

endif

if SHIELD_1984_LEFT || SHIELD_1984_RIGHT
config ZMK_SPLIT
  default y

endif
```

## rev1/zmk-config/config/boards/shields/nrf5340/Kconfig.shield
```kconfig
config SHIELD_1984_LEFT
    def_bool $(shields_list_contains,nrf5340_left)

config SHIELD_1984_RIGHT
    def_bool $(shields_list_contains,nrf5340_right)
```

## zmk-config/config/boards/shields/1984x/Kconfig.defconfig
```kconfig
if SHIELD_1984X_LEFT

config ZMK_KEYBOARD_NAME
  default "1984x"

config ZMK_SPLIT_ROLE_CENTRAL
  default y

endif

if SHIELD_1984X_LEFT || SHIELD_1984X_RIGHT
config ZMK_SPLIT
  default y

endif
```
